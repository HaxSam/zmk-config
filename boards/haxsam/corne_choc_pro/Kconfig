## boards/haxsam/corne_choc_pro/Kconfig.corne_choc_pro
```kconfig
# Copyright (c) 2020 The ZMK Contributors
# SPDX-License-Identifier: MIT

config BOARD_CORNE_CHOC_PRO_LEFT
    select SOC_NRF52840_QIAA
    imply ZMK_SPLIT_ROLE_CENTRAL
    imply USB_NRFX
    imply USB_DEVICE_STACK
    imply BT_CTLR
    imply I2C
    imply ZMK_MAX17048

config BOARD_CORNE_CHOC_PRO_RIGHT
    select SOC_NRF52840_QIAA
    imply USB_NRFX
    imply USB_DEVICE_STACK
    imply BT_CTLR
    imply I2C
    imply ZMK_MAX17048

config BOARD_ENABLE_DCDC
    bool "Enable DCDC mode"
    select SOC_DCDC_NRF52X
    default y
    depends on (BOARD_CORNE_CHOC_PRO_LEFT || BOARD_CORNE_CHOC_PRO_RIGHT)
    
```

## boards/haxsam/corne_choc_pro/board.yml
```yaml
boards:
  - name: corne_choc_pro_left
    vendor: haxsam
    socs:
      - name: nrf52840
  - name: corne_choc_pro_right
    vendor: haxsam
    socs:
      - name: nrf52840
```
